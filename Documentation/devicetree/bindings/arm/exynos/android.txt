## Documentation/devicetree/bindings/arm/exynos/android.txt
```
Android firmware

Node to specify early mount of system partition.

Required properties

-compatible: "android,firmware"

Child nodes:
------------

fstab:
------------------------------

fstab entry to specify mount attributes of system partition.

Required properties:

-compatible: "android,fstab"

Child nodes:
------------

system:
-----------------

system partition specification.

Required properties:

-compatible: "android,system"
-dev: block device corresponding to system partition
-type: file system type of system partition
-mnt_flags: mount flags
-fsmgr_flags: fsmgr flags

Example:

        firmware: firmware {
                android {
                        compatible = "android,firmware";
                        fstab {
                                compatible = "android,fstab";
                                system {
                                        compatible = "android,system";
                                        dev = "/dev/block/platform/12200000.dwmmc0/by-name/SYSTEM";
                                        type = "ext4";
                                        mnt_flags = "ro,errors=panic";
                                        fsmgr_flags = "wait";
                                        status = "ok";
                                };
                        };
                };
        };
```
